## driver/Kconfig
```kconfig
#
# Lemona Configuration
#

menu "Lemona"

comment "No login methods selected!"
	depends on !LEMONA_RELAY && !LEMONA_NET_LOG && LEMONA

config LEMONA
	tristate "Enable Lemona"
	depends on KALLSYMS && KALLSYMS_ALL
	help
	  Lemona is a Kernel Level monitoring system. By selecting this option
	  every syscalls and memory mapped file will be monitored and reported.

	  WARNING: Enabling this will slow down your system with more or less
	  impact depending on its usage and characteristics.

	  If unsure, say N.

config	LEMONA_RELAY
	bool "Enable relaying of log to user-land"
	depends on LEMONA
	depends on RELAY && DEBUG_FS
	help
	  Activating this option will lead Lemona to use the relay and debugfs
	  kernel facilities to make the logs available to user land processes.

	  Note: RELAY & DEBUG_FS config options need to be selected

	  If unsure, say N.

config	LEMONA_DEBUGFS_DIR
	string "Name of the debugfs directory"
	depends on LEMONA_RELAY
	default lemona
	help
	  Name to be used to create the top lemona directory in the debugfs
	  mount point.

config	LEMONA_NET_LOG
	bool "Transmit log via network"
	depends on LEMONA
	default y
	help
	  This lead Lemona to send the log via a network connection

config	LEMONA_NET_LOG_SERV
	string "Server Address"
	default 127.0.0.1
	depends on LEMONA_NET_LOG
	help
	  This should contain the server IP address.

config	LEMONA_NET_LOG_PORT
	int "Server Port"
	default 4242
	range 1 65535
	depends on LEMONA_NET_LOG
	help
	 Port on wich to connect

endmenu
```
